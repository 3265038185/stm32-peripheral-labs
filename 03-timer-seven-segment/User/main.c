#include "stm32f10x.h"     
#include "DELAY.h"
#include "OLED.h"
//#include "register.h"
//#include "bit.h"
//#include "Song.h"
//#include "led.h"
//#include "Key.h"
#include "Timer.h"
#include "Nixie.h"

/*====================================================================
 * 文件说明：3-12 定时器数码管 —— 主程序
 * -------------------------------------------------------------------
 * 本实验用到的知识点：
 *   1. 定时器中断：TIM2 每 1 秒触发一次更新中断，数码管数字加 1
 *      （0~9 循环）；TIM3 每 1 毫秒触发一次更新中断，负责数码管
 *      "动态扫描"（轮流点亮每一位，利用视觉暂留让 4 位同时亮）。
 *   2. 数码管显示：段码由 PA0~PA7 输出（共阳数码管，低电平点亮），
 *      位选由 PB12~PB15 控制（高电平选中某一位）。
 *   3. 中断服务函数（IRQHandler）：定时器溢出后硬件自动跳转过来，
 *      不需要我们手动调用，也不需要放在 main 的 while 循环里。
 * -------------------------------------------------------------------
 * 注意：真实工程一般把代码分模块封装，这里把显示逻辑直接写在
 *       中断函数里，只是为了让初学者直观理解定时器中断的工作方式。
 *====================================================================*/

/* 全局变量（供中断函数和主函数共同使用）：
 *   Num1     —— TIM2 中断里计数，0~9 循环，4 位数码管都显示它
 *   Num2     —— TIM3 中断里计数，0~4 循环，用来演示动态扫描
 *   NumCount —— 预留备用变量（本工程暂未使用） */
unsigned int Num1 = 0,Num2 = 0,NumCount = 0;
/* 主函数：只负责初始化。初始化完成之后，程序没有 while(1) 死循环，
 * 所有"周期性工作"（计数、刷新数码管）都由定时器中断自动完成。 */
int main(void)
{

	
	/* 初始化数码管：PA0~PA7 设为推挽输出（段码），PB12~PB15 设为推挽输出（位选） */
	Nixie_Init();

	/* 初始化定时器2：配置成每 1 秒触发一次更新中断（具体参数见 Timer.c）
	 * 注意：初始化时并没有立即启动计时，还要等 TIM_Cmd 使能 */
	Timer2_Init();

//	Timer3_Init();
	
}
/*====================================================================
 * TIM2 更新中断服务函数（每 1 秒自动进入一次）
 * -------------------------------------------------------------------
 * 这个函数不是我们手动调用的：TIM2 计数器从 0 加到自动重装值
 * （9999）后溢出，硬件就把 CPU 拽到这里来执行。
 * 作用：每隔 1 秒，让 4 位数码管都显示一个 0~9 循环递增的数字。
 * 注意：中断服务函数要尽量短小精悍，不要在中断里做耗时操作，
 *       否则会耽误其他程序（比如 TIM3 的扫描）的执行。
 *====================================================================*/
void TIM2_IRQHandler(void)
{
	/* TIM_GetITStatus：读取"更新中断"的标志位，判断是不是它引起的中断
	 * （定时器还有其他中断源，比如捕获/比较，所以要逐个判断） */
	if(TIM_GetITStatus(TIM2,TIM_IT_Update) == SET)
	{
		/* 4 位数码管全部显示同一个数字 Num1，方便观察计数效果
		 * （参数 1：第几位；参数 2：显示的数字） */
		Nixie_ShowNum(1,Num1);
		Nixie_ShowNum(2,Num1);
		Nixie_ShowNum(3,Num1);
		Nixie_ShowNum(4,Num1);
		Num1++;		// 每进一次中断（每 1 秒）数字加 1
		
		if(Num1==10)	// 计数到 10 就清零，实现 0~9 循环
		{
			Num1=0;
		}
		/* TIM_ClearITPendingBit：软件清除更新中断标志位。
		 * 不清除的话，中断标志一直为 1，退出中断后会立刻再次进入，
		 * 程序就会卡死在中断里，所以这一步非常重要！ */
		TIM_ClearITPendingBit(TIM2,TIM_IT_Update);
		
	}
}
/*====================================================================
 * TIM3 更新中断服务函数（每 1 毫秒自动进入一次）
 * -------------------------------------------------------------------
 * 作用：做数码管"动态扫描"。因为 4 位数码管共用同一组段码线
 * （PA0~PA7），同一时刻只能让 1 位亮，所以程序轮流快速点亮
 * 第 1、2、3、4 位。扫描速度足够快（每 1ms 换一位）时，人眼
 * 有视觉暂留效应，看起来 4 位就好像"同时"都在亮。
 * 演示效果：第 Num2 位显示数字 Num2，1~5 循环。
 *====================================================================*/
void TIM3_IRQHandler(void)
{
	if(TIM_GetITStatus(TIM3,TIM_IT_Update) == SET)
	{
		Num2++;		// 扫描位置加 1
		/* 先把 4 个位选引脚全部拉低（熄灭所有位）。
		 * 注意：必须先"消隐"再点亮新的一位，否则切换瞬间旧位
		 * 的残影会串到新位上，造成显示重影/拖尾。 */
		GPIO_ResetBits(GPIOB,GPIO_Pin_12|GPIO_Pin_13|GPIO_Pin_14|GPIO_Pin_15);
		Nixie_ShowNum(Num2,Num2);	// 点亮第 Num2 位，并送上数字 Num2 的段码
		//Nixie_ShowNum(Num2,10);
		if(Num2==5)		// 扫描到 5 后清零，让 Num2 在 1~5 之间循环
		{
			Num2=0;
		}
		TIM_ClearITPendingBit(TIM3,TIM_IT_Update);	// 清除更新中断标志，防止反复进中断
	}
}


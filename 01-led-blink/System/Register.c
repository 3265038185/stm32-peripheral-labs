/*****************************************************************************
 * 文件名：Register.c（System 系统层）
 * 所属工程：1-LED闪烁
 *
 * 【文件功能】
 *   用"直接操作寄存器"的方式驱动 10 个 LED（PA0~PA7 + PB0~PB1），
 *   三种玩法：Register(1) 全亮全灭、Register(2) 流水灯、Register(3) 两组交替。
 *
 * 【与另外两种写法的对比】
 *   - Function.c：用库函数 GPIO_SetBits 等，内部封装了寄存器操作；
 *   - 本文件：跳过库函数，直接读写寄存器 RCC->APB2ENR、GPIOx->CRL、GPIOx->ODR；
 *   - Bit.c：位带操作宏。三者效果相似，本文件能让你看清"库函数背后是什么"。
 *
 * 【涉及的三个寄存器】
 *   1. RCC->APB2ENR（APB2 外设时钟使能寄存器）：
 *      bit2 = 1 → 使能 GPIOA 时钟；bit3 = 1 → 使能 GPIOB 时钟。
 *      0x0000000C = 二进制 1100，即 bit2、bit3 同时置 1。
 *      外设不开时钟时，寄存器写不进去，程序可能 HardFault！
 *   2. GPIOx->CRL（端口配置低寄存器，管 PA0~PA7）：
 *      每 4 个 bit 管一个引脚（MODEx[2:0] + CNFx[1:0]）。
 *      0x33333333 = 每 4 位都是 0011：
 *        MODE=11 → 输出模式，最大速度 50MHz；
 *        CNF=00 → 通用推挽输出。
 *      → 把 PA0~PA7（和 PB0~PB7）都配成"推挽输出 50MHz"。
 *   3. GPIOx->ODR（输出数据寄存器）：
 *      每一位对应一个引脚，写 0 = 低电平（LED 亮），写 1 = 高电平（LED 灭）。
 *****************************************************************************/
#include "stm32f10x.h"  
#include "Delay.h"
/*****************************************************************************
 * 函数名：Register
 * 功能：  用寄存器操作驱动 10 个 LED，三种玩法
 * 参数：  x = 1：全部 LED 一起闪烁；x = 2：流水灯；x = 3：两组交替亮灭
 * 返回值：无
 *
 * 【重要提醒】
 *   本函数一进来就"重新配置"了 GPIO 模式（写 CRL）并开启了 GPIO 时钟，
 *   所以即使 main 里没调 LED_Init() 也能工作——这就是"寄存器法"的独立性。
 *   缺点：它把 PB 的 CRL 也全部写成 0x33333333（PB0~PB7 全配成输出），
 *   实际只用了 PB0、PB1，多配置的引脚无碍，但初学者要知道这个差别。
 *****************************************************************************/
void Register(int x)
{
	RCC->APB2ENR = 0x0000000c;      //使能 GPIOA（bit2）和 GPIOB（bit3）的时钟：0x0C = 0000 1100
	GPIOA->CRL = 0x33333333;        //PA0~PA7 全部配成推挽输出、50MHz（每 4 位 = 0011）
	GPIOB->CRL = 0x33333333;        //PB0~PB7 全部配成推挽输出、50MHz（本工程只用到 PB0/PB1）
	//======== 模式 1：全部 LED 一起闪烁 ========
	//原理：ODR 全部写 0 → 全亮；全部写 1 → 全灭。
	//ODR 寄存器每一位对应一个引脚：bit0=PA0/PB0，bit1=PA1/PB1……以此类推。
	if(x==1)
	{
		while(1)                        //死循环：全亮→全灭→全亮……
		{	
			GPIOB->ODR = 0x00000000;    //PB 全部引脚输出低电平 → LED8、LED9 亮
			GPIOA->ODR = 0x00000000;    //PA 全部引脚输出低电平 → PA0~PA7 全亮
			Delay_ms(500);              //全亮保持 500ms
			GPIOB->ODR = 0x0000000f;    //PB0~PB3 置 1 输出高电平（PB0/PB1 灭；
			                            //PB2/PB3 没接 LED，写不写都无影响）
			GPIOA->ODR = 0x000000ff;    //PA0~PA7 全部置 1 输出高电平 → 全灭
			Delay_ms(500);              //全灭保持 500ms，回到循环开头
				
		}
	}
	//======== 模式 2：流水灯 ========
	//原理：每次只把"下一个要亮的灯"对应的位写 0，其他位保持 1，
	//把 16 位 ODR 一次性整体赋值，逐个"移动"亮点。
	else if(x==2)
	{
		while(1)                        //死循环：流水过程反复播放
		{
			GPIOB->ODR = 0x00000001;    //bit0=0 → PB0 亮（LED8）；bit1=1 → PB1 灭
			Delay_ms(500);              //亮 500ms
			GPIOB->ODR = 0x00000002;    //bit1=0 → PB1 亮（LED9）；bit0=1 → PB0 灭
			Delay_ms(500);              //亮 500ms
			GPIOB->ODR = 0x00000003;    //PB0、PB1 都灭（为下一步过渡准备，短暂停留）
			                             //注意这里没有延时，立即进入 PA 部分


			GPIOA->ODR = 0x0000007f;    //0x7F = 0111 1111：bit7=1，bit0~6=0
			                            //→ PA7 灭，PA0~PA6 亮（亮点从 PB 组移到了 PA 组）
			Delay_ms(500);              //亮 500ms
			GPIOA->ODR = 0x000000bf;    //0xBF = 1011 1111：bit6=1 → PA6 灭，其余亮
			Delay_ms(500);              //亮 500ms
			GPIOA->ODR = 0x000000df;    //0xDF = 1101 1111：bit5=1 → PA5 灭
			Delay_ms(500);              //亮 500ms
			GPIOA->ODR = 0x000000ef;    //0xEF = 1110 1111：bit4=1 → PA4 灭
			Delay_ms(500);              //亮 500ms
			GPIOA->ODR = 0x000000f7;    //0xF7 = 1111 0111：bit3=1 → PA3 灭
			Delay_ms(500);              //亮 500ms
			GPIOA->ODR = 0x000000fb;    //0xFB = 1111 1011：bit2=1 → PA2 灭
			Delay_ms(500);              //亮 500ms
			GPIOA->ODR = 0x000000fd;    //0xFD = 1111 1101：bit1=1 → PA1 灭
			Delay_ms(500);              //亮 500ms
			GPIOA->ODR = 0x000000fe;    //0xFE = 1111 1110：bit0=1 → PA0 灭
			Delay_ms(500);              //亮 500ms
			GPIOA->ODR = 0x000000ff;    //全部置 1 → PA0~PA7 全灭，回到循环开头
			
		}
	}
	//======== 模式 3：两组交替亮灭 ========
	//原理：一组（PB0~PB1 全亮 + PA0~PA4 亮）与另一组（PA0~PA4 灭、
	//PA5~PA7 亮）交替。注意：ODR 是"整 16 位一起写"，前后状态会覆盖，
	//所以要仔细算好每一位的值，这正是直接操作寄存器"容易出错"的地方。
	else if(x==3)
	{
		while(1)                        //死循环：交替过程反复播放
		{
			GPIOB->ODR = 0x00000000;    //PB 全 0 → LED8、LED9 亮
			GPIOA->ODR = 0x0000001f;    //0x1F = 0001 1111：PA0~PA4 亮，PA5~PA7 灭
			                            //→ 此时亮的是：LED8、LED9 + LED0~LED4（共 7 个）
			Delay_ms(500);              //保持 500ms
			GPIOB->ODR = 0x0000000f;    //PB0~PB3 置 1 → LED8、LED9 灭
			GPIOA->ODR = 0x000000ff;    //PA0~PA7 全置 1 → PA 全部灭（全灭 500ms）
			Delay_ms(500);              //保持 500ms，回到循环开头
			                            //（两次循环合起来：亮 500ms、全灭 500ms 交替）

		}
	}
	
}

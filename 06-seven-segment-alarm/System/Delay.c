/* ============================================================================
 * 文件说明（Delay.c —— 延时函数文件）
 * ----------------------------------------------------------------------------
 * 延时方式有两种：
 *   1. Delay_us / Delay_ms / Delay_s：基于 SysTick（系统滴答定时器）的
 *      精确延时。SysTick 是 Cortex-M3 内核自带的 24 位递减计数器，
 *      挂在 HCLK（72MHz）上，每 1 微秒正好数 72 下，
 *      所以"要延时多少微秒 × 72"就是它要数的次数，非常精确。
 *   2. Dms()：纯软件空循环延时，靠 CPU 执行空语句"磨时间"，
 *      延时精度取决于编译器优化等级和主频，只适合粗略延时（如按键消抖）。
 * ========================================================================== */
#include "stm32f10x.h"

/**
  * @brief  微秒级延时
  * @param  xus 延时时长，范围：0~233015（因为 SysTick 是 24 位计数器，
  *        最大计数值 2^24-1，除以 72 就是最大微秒数）
  * @retval 无
  * 实现原理：让 SysTick 从"72×xus"往下数，数到 0 就是过了 xus 微秒
  */
void Delay_us(uint32_t xus)
{
	SysTick->LOAD = 72 * xus;				//设置定时器重装值
	                                       // HCLK=72MHz → 1us = 72 个时钟周期
	SysTick->VAL = 0x00;					//清空当前计数值
	                                       // 写 0 会同时清除 COUNTFLAG 标志，
	                                       // 保证从"满值"开始重新倒数
	SysTick->CTRL = 0x00000005;				//设置时钟源为HCLK，启动定时器
	                                       // bit0=1 使能 SysTick；
	                                       // bit2=1 时钟源选 HCLK(72MHz)；
	                                       // bit1=0 不产生中断（用轮询等待）
	while(!(SysTick->CTRL & 0x00010000));	//等待计数到0
	                                       // bit16 是 COUNTFLAG（计数到 0 时
	                                       // 硬件自动置 1），循环直到它为 1
	SysTick->CTRL = 0x00000004;				//关闭定时器
	                                       // 只保留 bit2（时钟源），bit0 清零
	                                       // → SysTick 停止工作，省电
}

/**
  * @brief  毫秒级延时
  * @param  xms 延时时长，范围：0~4294967295
  * @retval 无
  * 实现原理：循环调用 Delay_us(1000)，每循环一次延时 1 毫秒
  */
void Delay_ms(uint32_t xms)
{
	while(xms--)                     // xms 次循环，每轮延时 1ms
	{
		Delay_us(1000);              // 1ms = 1000us
	}
}
 
/**
  * @brief  秒级延时
  * @param  xs 延时时长，范围：0~4294967295
  * @retval 无
  * 实现原理：循环调用 Delay_ms(1000)，每循环一次延时 1 秒
  */
void Delay_s(uint32_t xs)
{
	while(xs--)                      // xs 次循环，每轮延时 1s
	{
		Delay_ms(1000);              // 1s = 1000ms
	}
} 

/* --------------------------------------------------------------------------
 * 函数功能：粗略的软件延时
 * 参数：time —— 延时"档数"，每档大约 1ms 左右（精度受主频/编译器影响）
 * 返回值：无
 * 实现原理：纯 CPU 空循环"磨时间"。i=12000 是一次延时循环的计数初值，
 * 每执行一次 while(i--) 空语句大约花几个时钟周期，12000 次约合 1ms。
 * 为什么不用 SysTick？按键消抖只需要"大概 20ms"的等待，
 * 用 SysTick 要开时钟、查标志，代码更长；空循环写法简单、足够用。
 * 缺点：延时期间 CPU 被"占死"，不能干其他事（阻塞式延时）
 * ------------------------------------------------------------------------ */
void Dms(int time)
{
   u16 i=0;  
   while(time--)                // 外层循环：time 个"档"
   {
      i=12000;  //自己定义     // 内层循环初值（约 1ms 一档，可自行调整）
      while(i--) ;             // 空循环，消耗 CPU 时间
   }
}

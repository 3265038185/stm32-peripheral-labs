/* ============================================================================
 * 文件说明（main.c —— 主程序文件）
 * ----------------------------------------------------------------------------
 * 本文件是"数码管闹钟 + LED 流水灯/呼吸灯"项目的核心控制文件，包含：
 *
 *   1. main() 主函数：依次初始化各硬件模块
 *      （数码管、按键中断、TIM2/TIM3 定时器、LED、PWM）
 *   2. TIM2_IRQHandler()   ：TIM2 更新中断服务函数，每 1 秒进入一次，
 *                            负责倒计时"秒"的累加、秒点闪烁、闹钟到点判定
 *   3. TIM3_IRQHandler()   ：TIM3 更新中断服务函数，每 1 毫秒进入一次，
 *                            负责 4 位数码管的"动态扫描"显示
 *   4. EXTI15_10/EXTI4/EXTI9_5_IRQHandler()：3 个按键的外部中断服务函数，
 *                            分别实现：开始/暂停、复位、设置分钟/秒数
 *
 * 用到的外设和知识点：
 *   定时器 TIM2、TIM3（基本定时功能 + 更新中断 + NVIC 中断优先级配置）
 *   外部中断 EXTI（按键输入检测，用到 PB4、PB6、PB9、PB10）
 *   数码管动态扫描（段选 PA0~PA7，位选 PB12~PB15，利用人眼视觉暂留）
 *   PWM 输出（TIM4 通道3 -> PB8，实现 LED 呼吸灯效果）
 *   LED 流水灯（PA8~PA11，低电平点亮）
 *
 * 学习方法提示：先看懂 main() 的初始化顺序，再分别理解两个定时器
 * 中断"各司其职"，最后看按键中断如何"指挥"定时器启停和设置时间。
 * ========================================================================== */
#include "stm32f10x.h"     
#include "DELAY.h"
#include "PWM.h"
#include "Timer.h"
#include "Nixie.h"
#include "NVIC.h"
#include "LED.h"

/* ---------- 全局变量说明（各中断服务函数之间通过这些变量交换信息） ---------- */
// Count：倒计时开始后"已经过去的秒数"。TIM2 每 1 秒中断一次就 +1，
//        显示时用"剩余秒数 = Sec - Count"，秒不够减时向分钟借位
unsigned int Count = 0;
// Shownum1~Shownum4：4 位数码管要显示的数字
//        Shownum1 = 剩余分钟的十位，Shownum2 = 剩余分钟的个位
//        Shownum3 = 剩余秒的十位，   Shownum4 = 剩余秒的个位
unsigned int Shownum1 = 0,Shownum2 = 0,Shownum3 = 0,Shownum4 = 0;
// Site：当前正在扫描的数码管位号（1~4 循环）
// Min ：设定的倒计时分钟数（0~99，由 PB9 按键调节）
// Sec ：设定的倒计时秒数（0~59，由 PB6 按键调节）
unsigned int Site = 0,Min=0,Sec = 0;
// timstate：计时器运行状态标志（0=停止，1=运行），由开始/暂停键切换
// Dot     ：秒点（小数点）显示标志，1=点亮、0=熄灭，每 1 秒闪一次
// time    ：秒点点亮时长的计数（以毫秒为单位，满 50 就熄灭秒点）
// Tmin    ：倒计时过程中"已经过去的整分钟数"（Count 满 61 秒时 +1）
// NowMin/NowSec：按开始/暂停键瞬间保存的剩余时间，复位键用来恢复
// Lightstate：倒计时进行标志（1=正在倒计时），用于闹钟到点判定
// ii      ：预留变量，当前代码中未使用
unsigned int timstate = 0,Dot = 0,time=0,Tmin= 0,NowMin = 0,NowSec=0,Lightstate=0,ii=0;
/* --------------------------------------------------------------------------
 * 主函数：程序从这里开始运行
 * 说明：这个工程的 main() 里没有 while(1) 死循环！
 *       因为本项目的"心跳"全部由中断驱动 —— 定时器一到时间、按键一被按下，
 *       芯片都会自动跳进对应的中断服务函数去执行，所以主程序只需要把
 *       各个外设初始化好，就可以"空闲"下来等待中断了。
 * 初始化顺序：数码管 -> 按键中断 -> 两个定时器 -> LED -> PWM
 * ------------------------------------------------------------------------ */
int main(void)
{

//	
	Nixie_Init();          // 初始化数码管：PA0~PA7 配置为推挽输出（段选），
	                       // PB12~PB15 推挽输出（位选），具体见 Nixie.c
	NVICKey_Init();        // 按键中断初始化（函数在 NVIC.h 中声明）
	                       // 注意：本工程现有的文件里没有给出它的实现，
	                       // 若要按键真正工作，需要补全 EXTI 和 NVIC 的配置代码
//Nixie_ShowNum(2,3);      // （原测试语句：让第 2 位数码管显示数字 3，已注释掉）
	Timer2_Init();         // 初始化 TIM2：预分频 7200-1、重装值 10000-1，
	                       // 72MHz 时钟下每 1 秒产生一次更新中断，用作"秒"计时
	Timer3_Init();         // 初始化 TIM3：预分频 7200-1、重装值 10-1，
	                       // 每 1 毫秒产生一次更新中断，用作数码管扫描节拍
	LED_Init();            // 初始化 4 个 LED：PA8~PA11 推挽输出，低电平点亮

	
	PWM_Init();            // 初始化 PWM：TIM4 通道3（PB8）输出，用于呼吸灯

	//PWM_LED();           // （原测试语句：直接播放呼吸灯效果，已注释掉，
	                       //   实际是在闹钟响铃时才调用 PWM_LED()）
	
}
/* --------------------------------------------------------------------------
 * TIM2 更新中断服务函数：每 1 秒自动进入一次（闹钟的"秒"计时器）
 * 定时计算：TIM2 时钟 = 72MHz（APB1 分频为 2 时定时器自动 ×2）
 *           计数频率 = 72MHz / (7200-1+1) = 10kHz，即每数一次 = 0.1ms
 *           重装值 = 10000，溢出一次 = 0.1ms × 10000 = 1000ms = 1 秒
 * 功能：
 *   1. 秒数 Count 加 1，同时点亮秒点（Dot = 1）
 *   2. 每满 61 秒让 Tmin 加 1（记录"已经过去的整分钟数"）
 *   3. 若显示时间已全部归零（分、秒都是 0），说明倒计时结束：
 *      执行 LED 流水灯 + PWM 呼吸灯，然后复位所有变量并关闭 TIM2
 * ------------------------------------------------------------------------ */
void TIM2_IRQHandler(void)
{
	
		// TIM_GetITStatus()：读取中断标志寄存器，判断"更新中断"标志是否为 1。
		// 定时器计数溢出（数到重装值）时，硬件会自动把该标志置 1
	if(TIM_GetITStatus(TIM2,TIM_IT_Update) == SET)
	{
		Lightstate = 1;     // 标记"倒计时正在进行中"（供闹钟到点判定使用）
		Count++;            // 已经过去的秒数 +1（每 1 秒执行一次）
		Dot = 1;            // 点亮秒点（小数点），提醒"又走了一秒"
		if(Count>60)        // 已经走了超过 60 秒（第 61 秒）时
		{
			Tmin++;         // 整分钟数 +1（相当于"剩余分钟"少了 1 分钟）
			Count = 0;      // 秒计数清零，从新的一分钟重新开始数
		}
		TIM_ClearITPendingBit(TIM2,TIM_IT_Update);   // 清除中断标志。
		                                            // 注意：如果不清除，CPU 会反复
		                                            // 进入中断，导致主程序被"卡死"
		// 闹钟到点判定：倒计时正在进行（Lightstate!=0），
		// 且 4 位数码管要显示的数字全部为 0（剩余分、剩余秒都为 0）
		if(Lightstate!=0&&Shownum1 ==0&&Shownum2 ==0&&Shownum3 ==0&&Shownum4 ==0)
		{
			
			TIM_ClearITPendingBit(TIM2,TIM_IT_Update); // 再次清除标志（双保险）
			LED_Run();      // ① 流水灯效果：4 个 LED 依次点亮、跑一个来回
			PWM_LED();      // ② 呼吸灯效果：PWM 占空比从 0 渐亮到 100 再渐暗，循环 3 次
			Tmin = 0;       // ↓ 闹钟响完后，把所有计数变量全部复位，
			Min = 0;        //   为下一次倒计时"清零重新开始"做准备
			TIM_Cmd(TIM2,DISABLE);  // 关闭 TIM2（停止计时）。
			                        // 注意：Timer2_Init 里没有开启 TIM2，
			                        // 是靠开始/暂停键（TIM_Cmd ENABLE）启动的
			Lightstate = 0; // 清除"倒计时进行中"标志
			Count = 0;      // 秒计数清零
			Dot = 0;        // 熄灭秒点
			Site = 0;       // 数码管扫描位号清零
			Min=0;          // 分钟清零
			Sec = 0;        // 秒清零
			time = 0;       // 秒点点亮计时清零
			
		}
	}
	
}

/* --------------------------------------------------------------------------
 * TIM3 更新中断服务函数：每 1 毫秒自动进入一次（数码管的"刷新"节拍）
 * 定时计算：计数频率 = 72MHz / 7200 = 10kHz，重装值 = 10，
 *           溢出一次 = 0.1ms × 10 = 1ms
 * 功能：4 位数码管的"动态扫描"显示
 *   【动态扫描原理】人眼有视觉暂留效应（约 0.1 秒），只要轮流点亮每一位
 *   数码管、且刷新足够快（每秒几十次以上），看起来就像 4 位同时点亮。
 *   本程序 1ms 点亮一位，4 位轮流一遍只要 4ms，
 *   刷新率 = 1/4ms = 250Hz，画面稳定不闪烁。
 * ------------------------------------------------------------------------ */
void TIM3_IRQHandler(void)
{
	if(TIM_GetITStatus(TIM3,TIM_IT_Update) == SET)   // 判断 TIM3 更新中断标志
	{
	
		Site ++;                        // 切换到下一位数码管（1→2→3→4→1…循环）
		// 计算 4 位要显示的数字（把"剩余时间"拆成 4 个数字）：
		//   剩余分钟 = Min - Tmin（设定分钟 - 已过去的整分钟数）
		//   剩余秒   = Sec - Count（设定秒 - 已过去的秒数）
		Shownum1 = (Min - Tmin)/10;     // 第 1 位：剩余分钟的十位
		Shownum2 = (Min - Tmin)%10;     // 第 2 位：剩余分钟的个位
		Shownum3 = (Sec - Count)/10;    // 第 3 位：剩余秒的十位
		Shownum4 = (Sec - Count)%10;    // 第 4 位：剩余秒的个位
		if(Count!=0)                    // 已经走过的秒数不为 0 时才需要判断借位
		{
			if(Sec < Count)             // 剩余秒数（Sec-Count）变成负数了 → 秒不够减
			{
				Count=0;                // 秒计数清零
				Sec = 59;               // 秒显示改为 59（相当于向"分"借了 1 分钟）
				Min--;                  // 分钟减 1（借位）
				
			}
		}
		
		// 位选消隐：先把 4 个位选引脚全部拉低（熄灭所有位）。
		// 为什么必须这样？如果不先全部熄灭，切换到下一位的瞬间，
		// 上一位的数字会残留（有"残影"、数字串扰）。先全灭再点亮一位
		// 就能保证任何时刻只有一位在显示
		GPIO_ResetBits(GPIOB,GPIO_Pin_12|GPIO_Pin_13|GPIO_Pin_14|GPIO_Pin_15);
		if(Site == 1)                   // 正在扫描第 1 位：显示"分钟十位"
		{
			Nixie_ShowNum(Site,Shownum1);
		}
		if(Site == 2)                   // 正在扫描第 2 位：显示"分钟个位"
		{
			if(Dot==0)                  // 秒点熄灭状态 → 正常显示数字
			{
			Nixie_ShowNum(Site,Shownum2);
			}
			if(Dot == 1)                // 秒点点亮状态（每 1 秒由 TIM2 置 1）
			{
				Nixie_ShowDotNum(Site,Shownum2);  // 显示"带小数点的数字"（dp 段点亮），
				                                  // 模拟电子表里冒号"闪烁"的效果
				time++;                 // 秒点点亮时间计数（每毫秒 +1）
				if(time==50)            // 点亮满 50 毫秒后
				{
					Dot = 0;            // 熄灭秒点（0.95 秒熄灭，0.05 秒点亮）
					time = 0;           // 计数清零，等待下一次点亮
				}
			}
			
		}
		if(Site == 3)                   // 正在扫描第 3 位：显示"秒十位"
		{
			
			Nixie_ShowNum(Site,Shownum3);
		
		}
		if(Site == 4)                   // 正在扫描第 4 位：显示"秒个位"
		{
			Nixie_ShowNum(Site,Shownum4);
		}
		if(Site==5)                     // 扫描完第 4 位后 Site 变成了 5
		{
			Site=0;                     // 归零，下一次中断从第 1 位重新开始（4 位循环）
		}
		
		TIM_ClearITPendingBit(TIM3,TIM_IT_Update);   // 清除更新中断标志，否则中断会不断重入
	}
}
/* --------------------------------------------------------------------------
 * 外部中断服务函数（PB10 按键 —— 开始/暂停键）
 * 按键一端接 PB10，按下时引脚电平被拉低（低电平有效）
 * 功能：按一下 → 开始倒计时（启动 TIM2）；再按一下 → 暂停（停止 TIM2）
 * 附加功能：每次按下都会把"当前剩余时间"保存到 NowMin / NowSec，
 *           供"复位键"恢复使用
 * 注意：PB10 属于 EXTI 线 10，由 EXTI15_10_IRQHandler 这一个入口统一服务
 * ------------------------------------------------------------------------ */
void EXTI15_10_IRQHandler(void)
{

	if(EXTI_GetITStatus(EXTI_Line10)==SET)     // EXTI 线 10（对应 PB10）中断标志是否为 1
	{
		NowMin = Min;                          // 保存当前剩余分钟（复位键要恢复到这里）
		NowSec = Sec;                          // 保存当前剩余秒数
		EXTI_ClearITPendingBit(EXTI_Line10);   // 清除外部中断标志，否则中断会不断触发
		Dms(20);                               // 软件延时约 20ms —— 按键消抖。
		                                       // 【消抖原理】机械按键按下/松开的瞬间
		                                       // 触点会"弹跳"，产生几十毫秒的电平抖动，
		                                       // 若不做消抖，一次按压会被误判成多次
		if(GPIO_ReadInputDataBit(GPIOB,GPIO_Pin_10)==0)  // 延时后再读引脚：
		                                                // 确认按键确实按着（低电平=0）
		{	if(timstate==0)                    // 当前是"停止"状态？
			{
				TIM_Cmd(TIM2,ENABLE);          // 启动 TIM2 —— 倒计时开始（每 1 秒中断一次）
			timstate = 1;                      // 状态标志改为"运行中"
			}
			else                               // 当前是"运行"状态？
			{TIM_Cmd(TIM2,DISABLE);            // 停止 TIM2 —— 倒计时暂停
			timstate = 0;                      // 状态标志改回"停止"
			}
		}
	}
	
}

/* --------------------------------------------------------------------------
 * 外部中断服务函数（PB4 按键 —— 复位键）
 * 功能：把倒计时时间恢复成"最后一次按开始/暂停键时保存的时间"
 *       （NowMin / NowSec），同时停止计时、清空各种计数字段，
 *       相当于"回到保存的起点重新来过"
 * 注意：PB4 属于 EXTI 线 4，由 EXTI4_IRQHandler 这个入口独立服务
 * ------------------------------------------------------------------------ */
void EXTI4_IRQHandler(void)
{
	if(EXTI_GetITStatus(EXTI_Line4)==SET)      // EXTI 线 4（对应 PB4）中断标志是否为 1
	{		
		EXTI_ClearITPendingBit(EXTI_Line4);    // 清除外部中断标志
		Dms(20);                               // 软件延时约 20ms —— 按键消抖
		if(GPIO_ReadInputDataBit(GPIOB,GPIO_Pin_4)==0)   // 延时后再读引脚，确认按键按下（低电平）
		{  
			TIM_Cmd(TIM2,DISABLE);             // 先停止计时
			Min=NowMin ;                       // 恢复保存的剩余分钟
			Sec=NowSec ;                       // 恢复保存的剩余秒数
			//Sec = 0;                         // （原来的备用写法，已注释掉）
			Count= 0;                          // 已过去的秒数清零
			timstate = 0;                      // 计时状态改为"停止"
			Dot = 0;                           // 熄灭秒点
			Tmin= 0;                           // 已过去的整分钟数清零
			time=0;                            // 秒点点亮计时清零
		}	
		
	}
}

/* --------------------------------------------------------------------------
 * 外部中断服务函数（PB9 / PB6 按键 —— 设置键）
 * 功能：在倒计时开始前用来设置倒计时时间
 *       PB9 每按一下：分钟 Min +1（最大 99，超出归零）
 *       PB6 每按一下：秒数  Sec +1（最大 59，超出归零）
 * 【重要知识点】EXTI 线 5~9 共用一个中断入口（EXTI9_5_IRQHandler），
 *   所以进入函数后必须分别判断"到底是哪条线触发的"，再分别处理。
 *   同理 EXTI 线 10~15 共用 EXTI15_10_IRQHandler 入口。
 * ------------------------------------------------------------------------ */
void EXTI9_5_IRQHandler(void)
{
	if(EXTI_GetITStatus(EXTI_Line9)==SET)      // 是 EXTI 线 9（PB9，分钟键）触发的？
	{		
		EXTI_ClearITPendingBit(EXTI_Line9);    // 清除该线的中断标志
		Dms(20);                               // 软件延时约 20ms —— 按键消抖
		if(GPIO_ReadInputDataBit(GPIOB,GPIO_Pin_9)==0)   // 确认按键按下（低电平）
		{   Min++;                             // 分钟数 +1
			if(Min>99)                         // 超过 99 分钟（数码管最多显示两位数）
			{
				Min=0;                         // 归零，重新从 0 开始加
			}
		}	
	}
	
	if(EXTI_GetITStatus(EXTI_Line6)==SET)      // 是 EXTI 线 6（PB6，秒数键）触发的？
	{
		EXTI_ClearITPendingBit(EXTI_Line6);    // 清除该线的中断标志
		Dms(20);                               // 软件延时约 20ms —— 按键消抖
		if(GPIO_ReadInputDataBit(GPIOB,GPIO_Pin_6)==0)   // 确认按键按下（低电平）
		{   Sec++;                             // 秒数 +1
			if(Sec>59)                         // 超过 59 秒（1 分钟只有 60 秒）
			{
				Sec=0;                         // 归零，重新从 0 开始加
			}
		}	
	}
}

	

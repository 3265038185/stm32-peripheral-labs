/*=============================================================================
 * 文件：main.c（波形项目的主函数文件）
 * 项目功能：用 ADC 采集输入信号的电压，配合定时器 TIM3 定时采样，
 *           当检测到信号电平"稳定在中间值附近"时，把最近 128 个采样点
 *           画成波形显示在 OLED 上（一个简易"示波器"）。
 *
 * 用到的外设/知识点：
 *   1. ADC1（PA0 通道0）：模拟-数字转换，单次转换，结果 0~4095 对应 0~3.3V
 *   2. TIM3（定时器中断）：定时触发中断，在中断里定时采样 ADC
 *      （预分频 72-1 把 72MHz 降到 1MHz，计数 100-1，溢出周期 = 100us，
 *       即每 100 微秒采一次样）
 *   3. 中断采样 + 主循环显示：中断里把数据存进数组，主循环里画波形，
 *      两者通过标志位（flagc、flaga、flagd 等）配合
 *   4. OLED 画点显示波形（128 个点，横坐标 0~127，纵坐标 0~63）
 *
 * 整体工作流程：
 *   1. 初始化 ADC、OLED、TIM3
 *   2. TIM3 中断每 100us 采一次 ADC，结果存进 AD_Value[a]，a 到 128 归零
 *   3. 主循环判断：若最近两次采样值都在"中间值±100"范围内（信号稳定），
 *      且之前没采完过一屏，则先停定时器、再启动定时器重新采样
 *   4. 当一屏 128 个点采完后（flagc==1），清屏并把 128 个点画到 OLED 上
 *
 * 注：文件中有大量被注释掉的调试代码，理解主流程后可以忽略它们
 *=============================================================================*/
#include "stm32f10x.h"                  // Device header
#include "Delay.h"                      // 延时函数头文件
#include "OLED.h"                       // OLED 显示函数头文件
#include "AD.h"                         // ADC 和定时器相关函数头文件
int i;			//全局变量 i：for 循环计数变量，作屏幕横坐标（0~127）
uint8_t t = 1;	//全局变量 t：预留的状态变量（本程序主循环暂未使用）
uint16_t flaga = 0;	//全局标志 flaga：=1 表示"检测到信号稳定，重新开始采样"
uint16_t flagd = 0;	//全局标志 flagd：=1 表示"已进入稳定触发状态，防止重复触发"
int main(void)
{
	
		AD_Init();		//AD初始化：配置 ADC1（PA0 单次转换）
	/*模块初始化*/
	OLED_Init();				//OLED初始化：点亮屏幕并清屏
			//AD初始化（注释掉的空位置，真正的初始化在上面一行）
	
	Delay_ms(100);		//延时 100ms：等 OLED 和 ADC 稳定后再开定时器
	Tim_Init();			//定时器初始化：配置 TIM3 每 100us 进一次中断采样
	
//	OLED_DrawPoint(i,(uint8_t)((float)AD_Value[(uint8_t)7.8*i]/4095*63));
//	while(1)
//	{
//		for(i=0;i<128;i++)
//		
//		
//		OLED_Clear();
//	}
	//	OLED_ShowNum(2,1,4095*63,9);
//	flagt = 0;
//	//Delay_ms(100);
////	flagt1 = 1;
//	flagc = 0;
	while (1)		//主循环：不断检测采样状态并刷新波形显示
	{
		/* 触发条件判断：找"信号稳定段"作为触发点，让波形每次都从同一位置开始画，
		 * 效果类似示波器的"触发功能"，画面稳定不飘。
		 * 4095/2 ≈ 2047.5 是 1.65V 对应的 ADC 值（满量程一半）：
		 *   条件1：Same 在 2047.5±100 范围内（电平接近中间值）
		 *   条件2：flagd==0（上一次触发还没完成，避免重复触发）
		 *   条件3：Same2 > Same（信号处于上升沿，检测到上升沿过中点才触发） */
		if( 4095/2-100<Same&&Same<((uint16_t)4095/2+100)&&flagd==0&&Same2>Same)
		{
			//OLED_Clear();
			
			/* 触发成功！执行"重采"三步曲： */
			TIM_Cmd(TIM3,DISABLE);		//先停定时器：暂停中断采样
			flagc = 0;					//清"一屏采完"标志
			flagb = 0;					//清"开始采样"标志（中断里靠它判断是否从头存）
			TIM_Cmd(TIM3,ENABLE);		//再开定时器：重新从 AD_Value[0] 开始采样
			flaga= 1;					//置位：表示"新一屏采样正在进行"
			
			flagd = 1;					//置位：防止这次触发过程中再次触发
			
		}
		//TIM_Cmd(TIM3,DISABLE);
		/* 显示条件判断：flagc==1 表示 TIM3 中断里已经采满 128 个点（一屏），
		 * flaga==1 表示这一屏确实是刚触发的数据，两个条件都满足才画 */
		if(flagc == 1&&flaga ==1)
			{
				OLED_Clear();			//清屏：擦掉上一帧画面
				for(i=0;i<128;i++)		//循环 128 次，画 128 个采样点
				{
				/* 在 (i, 纵坐标) 处画一个点：
				 * AD_Value[i] 是第 i 个采样值（0~4095）
				 * /4095*63：按比例映射到屏幕 0~63 的纵向范围（0V 在屏底，3.3V 在屏顶） */
				OLED_DrawPoint(i,(uint8_t)((float)AD_Value[i]/4095*63));
				}
				
				flaga = 0;				//清标志：这一屏已经画完
				flagd = 0;				//清标志：允许下一次触发
			}
	}
		
//		if(flagt == 1&&flagc == 0)
//			{
//		OLED_DrawPoint(index,(uint8_t)((float)AD_Value[0]/4095*63));
//				
//			}
//		if(flagc ==1)
//		{
//			TIM_Cmd(TIM3,DISABLE);
//			//Delay_ms(10);
//			flagt=0;
//			flagc = 0;
			//OLED_Clear();
			//TIM_Cmd(TIM3,ENABLE);
//		}
		
//	}
}

